## Documentation/devicetree/bindings/hwmon/aspeed2600-pwm-tacho.txt
```
ASPEED AST2600 PWM and Fan Tacho controller device driver

The ASPEED PWM controller can support upto 16 PWM outputs. The ASPEED Fan Tacho
controller can support upto 16 Fan tachometer inputs.

There can be upto 16 fans supported. Each fan can have one PWM output and
one Fan tach inputs.

Required properties for pwm-tacho node:
- #address-cells : should be 1.

- #size-cells : should be 0.

- #cooling-cells: should be 2.

- reg : address and length of the register set for the device.

- pinctrl-names : a pinctrl state named "default" must be defined.

- pinctrl-0 : phandle referencing pin configuration of the PWM ports.

- compatible : should be "aspeed,ast2600-pwm-tachometer".

- clocks : phandle to clock provider with the clock number in the second cell

- resets : phandle to reset controller with the reset number in the second cell

fan subnode format:
===================
Under fan subnode there can upto 16 child nodes, with each child node
representing a fan. There are 16 fans each fan can have one PWM port and one
Fan tach inputs.
For PWM port can be configured cooling-levels to create cooling device.
Cooling device could be bound to a thermal zone for the thermal control.

Required properties for each child node:
- reg : should specify PWM source port.
	integer value in the range 0x00 to 0x0f with 0x00 indicating PWM port 0
	and 0x0f indicating PWM port F.

- cooling-levels: PWM duty cycle values in a range from 0 to 255
                  which correspond to thermal cooling states.

- aspeed,fan-tach-ch : should specify the Fan tach input channel.
                integer value in the range 0 through 15, with 0 indicating
		Fan tach channel 0 and 15 indicating Fan tach channel 15.
		Atleast one Fan tach input channel is required.

- aspeed,target-pwm : Specify the frequency of PWM. The value range from 24 to
		      780000. Default value will be set to 25000.

- aspeed,pulse-pr : Specify tacho pulse per revolution of the fan. A general
		    parameter of pulse-pr is 2.

Examples:

&pwm_tacho {
	status = "okay";
	pinctrl-names = "default";
	pinctrl-0 = <&pinctrl_pwm0_default &pinctrl_tach0_default>;

	fan@0 {
		reg = <0x00>;
		aspeed,target-pwm = <25000>;
		cooling-levels = /bits/ 8 <125 151 177 203 229 255>;
		aspeed,fan-tach-ch = /bits/ 8 <0x00>;
		aspeed,pulse-pr = <2>;
	};
};
 
```

## Documentation/devicetree/bindings/hwmon/nct7601.txt
```
Nuvoton NCT7601 Hardware Monitoring IC

Required node properties:

 - "compatible": must be "nuvoton,nct7601"
 - "reg": I2C bus address of the device
 - #address-cells = <1>;
 - #size-cells = <0>;

Optional properties:
 - "sensor-diode": sets 6 differential inputs
   instead of default 8 thermistor inputs
 
Example nct7601 node:

nct7601-example@28 {
	compatible = "nuvoton,nct7601";
	reg = <0x28>;
	#address-cells = <1>;
	#size-cells = <0>;
    sensor-diode;
};
```
